## meta-leo/conf/layer.conf
```bitbake
# Copyright (c) 2019 Continental AG and subsidiaries

BBPATH .= ":${LAYERDIR}"

BBFILES += "${LAYERDIR}/recipes-*/*/*.bb \
	${LAYERDIR}/recipes-*/*/*.bbappend"

LAYERSERIES_COMPAT_beagent = "thud"

BBFILE_COLLECTIONS += "beagent"
BBFILE_PATTERN_beagent = "^${LAYERDIR}/"
BBFILE_PRIORITY_beagent = "6"

PREFERRED_VERSION_ecal = "5.2.14"
PREFERRED_VERSION_libmodbus = "3.1.4"
```
